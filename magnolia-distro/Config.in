## magnolia-distro/configs/magnolia_x86_64_defconfig
```kconfig
BR2_x86_64=y
BR2_x86_generic_64=y
BR2_PACKAGE_HOST_LINUX_HEADERS_CUSTOM_6_12=y
BR2_TOOLCHAIN_BUILDROOT_GLIBC=y
BR2_TOOLCHAIN_BUILDROOT_CXX=y
BR2_JLEVEL=4

# External Tree
BR2_EXTERNAL="../magnolia-distro"

# System
BR2_TARGET_GENERIC_HOSTNAME="magnolia"
BR2_TARGET_GENERIC_ISSUE="Welcome to Magnolia OS - Sovereign Operating System"
BR2_INIT_NONE=y
BR2_ROOTFS_DEVICE_CREATION_DYNAMIC_EUDEV=y

# RootFS Overlay & Post-Build
BR2_ROOTFS_OVERLAY="$(BR2_EXTERNAL_MAGNOLIA_PATH)/board/magnolia/x86_64/rootfs-overlay"
BR2_ROOTFS_POST_BUILD_SCRIPT="$(BR2_EXTERNAL_MAGNOLIA_PATH)/board/magnolia/x86_64/post-build.sh"

# Bootloader (GRUB2 EFI)
BR2_TARGET_GRUB2=y
BR2_TARGET_GRUB2_X86_64_EFI=y
BR2_TARGET_GRUB2_BUILTIN_MODULES_EFI="serial search search_label search_fs_uuid search_fs_file part_gpt ext2 fat all_video normal minicmd configfile linux boot gettext video_fb video_colors video terminfo gfxmenu png jpeg font gfxterm_background"

# Kernel
BR2_LINUX_KERNEL=y
BR2_LINUX_KERNEL_CUSTOM_VERSION=y
BR2_LINUX_KERNEL_CUSTOM_VERSION_VALUE="6.12.9"
BR2_LINUX_KERNEL_INSTALL_TARGET=y
BR2_LINUX_KERNEL_USE_CUSTOM_CONFIG=y
BR2_LINUX_KERNEL_CUSTOM_CONFIG_FILE="$(BR2_EXTERNAL_MAGNOLIA_PATH)/board/magnolia/x86_64/linux.config"

# Graphics (Wayland-only, dev GPU drivers only)
BR2_PACKAGE_CAGE=y
BR2_PACKAGE_MESA3D=y
BR2_PACKAGE_MESA3D_GALLIUM_DRIVER_VIRTIO=y
BR2_PACKAGE_MESA3D_GALLIUM_DRIVER_SOFTPIPE=y
BR2_PACKAGE_MESA3D_OPENGL_EGL=y
BR2_PACKAGE_MESA3D_OPENGL_ES=y
BR2_PACKAGE_MESA3D_GBM=y
BR2_PACKAGE_LIBGLVND=y
BR2_PACKAGE_LIBDRM=y
BR2_PACKAGE_WAYLAND=y
BR2_PACKAGE_WAYLAND_PROTOCOLS=y
BR2_PACKAGE_DBUS=y
BR2_PACKAGE_LIBGLIB2=y
BR2_PACKAGE_LIBGTK3=y
BR2_PACKAGE_LIBGTK3_WAYLAND=y
BR2_PACKAGE_WEBKITGTK=y
BR2_PACKAGE_CAIRO=y
BR2_PACKAGE_CAIRO_PNG=y
BR2_PACKAGE_CAIRO_ZLIB=y
BR2_PACKAGE_FREETYPE=y
BR2_PACKAGE_FONTCONFIG=y
BR2_PACKAGE_HARFBUZZ=y
BR2_PACKAGE_LIBEPOXY=y

# Networking
BR2_PACKAGE_NETWORK_MANAGER=y
BR2_PACKAGE_NETWORK_MANAGER_WIFI=y
BR2_PACKAGE_WPA_SUPPLICANT=y

# Filesystem & Image
BR2_TARGET_ROOTFS_EXT2=y
BR2_TARGET_ROOTFS_EXT2_4=y
BR2_TARGET_ROOTFS_EXT2_SIZE="512M"
BR2_ROOTFS_POST_IMAGE_SCRIPT="$(BR2_EXTERNAL_MAGNOLIA_PATH)/board/magnolia/x86_64/post-image.sh"
BR2_PACKAGE_HOST_GENIMAGE=y

# Magnolia packages
BR2_PACKAGE_MAGNOLIA_CORE=y
BR2_PACKAGE_MAGNOLIA_SUPERVISOR=y
BR2_PACKAGE_MAGNOLIA_INTERFACE=y
BR2_PACKAGE_HOST_NODEJS=y
```

## magnolia-distro/package/Config.in
```kconfig
# Custom Magnolia Packages Config.in
# Add source lines for new packages here

source "$BR2_EXTERNAL_MAGNOLIA_PATH/package/magnolia-supervisor/Config.in"
source "$BR2_EXTERNAL_MAGNOLIA_PATH/package/magnolia-core/Config.in"
source "$BR2_EXTERNAL_MAGNOLIA_PATH/package/magnolia-interface/Config.in"
```

## magnolia-distro/package/magnolia-core/Config.in
```kconfig
config BR2_PACKAGE_MAGNOLIA_CORE
	bool "magnolia-core"
	depends on BR2_PACKAGE_HOST_RUSTC_ARCH_SUPPORTS
	select BR2_PACKAGE_HOST_RUSTC
	select BR2_PACKAGE_OPENSSL # for cloud/reqwest
	help
	  The Magnolia OS Dashboard Hub.
	  Responsible for the user interface, system diagnostics,
	  and local-first application management.

	  https://github.com/burgmarcos/bos
```

## magnolia-distro/package/magnolia-interface/Config.in
```kconfig
config BR2_PACKAGE_MAGNOLIA_INTERFACE
	bool "magnolia-interface"
	help
	  The Magnolia OS GUI interface (React/Tauri assets).
```

## magnolia-distro/package/magnolia-supervisor/Config.in
```kconfig
config BR2_PACKAGE_MAGNOLIA_SUPERVISOR
	bool "magnolia-supervisor"
	depends on BR2_PACKAGE_HOST_RUSTC_ARCH_SUPPORTS
	select BR2_PACKAGE_HOST_RUSTC
	help
	  The Magnolia OS Supervisor (PID 1).
	  Responsible for early system initialization, mounting filesystems,
	  and launching the UI session (Magnolia Hub) via Cage.

	  https://github.com/burgmarcos/bos
```
